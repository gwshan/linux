## drivers/platform/arm64/mpam/Kconfig
```kconfig
# Confusingly, this is everything but the CPU bits of MPAM. CPU here means
# CPU resources, not containers or cgroups etc.
config ARM_CPU_RESCTRL
	bool
	default y
	depends on ARM64 && ARCH_HAS_CPU_RESCTRL
	depends on MISC_FILESYSTEMS
	select RESCTRL_RMID_DEPENDS_ON_CLOSID

config MPAM_KUNIT_TEST
	bool "KUnit tests for MPAM driver " if !KUNIT_ALL_TESTS
	depends on KUNIT=y
	default KUNIT_ALL_TESTS
	help
	  Enable this option to run tests in the MPAM driver.

	  If unsure, say N.
```

## drivers/resctrl/Kconfig
```kconfig
# Confusingly, this is everything but the CPU bits of MPAM. CPU here means
# CPU resources, not containers or cgroups etc.
config ARM64_MPAM_DRIVER
	bool "MPAM driver for System IP, e,g. caches and memory controllers"
	depends on ARM64_MPAM && EXPERT

menu "ARM64 MPAM driver options"

config ARM64_MPAM_DRIVER_DEBUG
	bool "Enable debug messages from the MPAM driver."
	depends on ARM64_MPAM_DRIVER
	help
	  Say yes here to enable debug messages from the MPAM driver.

config MPAM_KUNIT_TEST
	bool "KUnit tests for MPAM driver " if !KUNIT_ALL_TESTS
	depends on KUNIT=y
	default KUNIT_ALL_TESTS
	help
	  Enable this option to run tests in the MPAM driver.

	  If unsure, say N.

endmenu
```
